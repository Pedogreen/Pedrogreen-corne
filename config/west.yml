## config/west.yml
```yaml
manifest:
  remotes:
    - name: local
      url-base: https://github.com/YOUR_USERNAME

  projects:
    - name: zmk
      remote: zmkfirmware
      revision: main
      import: app/west.yml

    - name: zmk-layer-reporter
      remote: local
      revision: main
      path: modules/zmk-layer-reporter
```
