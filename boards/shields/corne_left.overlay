/ {
	hid_usage_table {
		compatible = "zmk,hid-usage-table";
layer_state_report: layer_state_report {
	usage_page = <0xFF00>;
	usage_id = <0x01>;
	report_id = <1>;
	logical_minimum = <0>;
	logical_maximum = <0xFF>;
	report_size = <8>;
	report_count = <1>;
};
	};
};

&usbd_hid {
	report_descriptors = <&layer_state_report>;
};
